#ifndef ROAD_H
#define ROAD_H

#include "cars.h"

#define ROAR_PARTS_ROWS       8
#define ROAD_PARTS_COLUMNS    4
#define ROAD_PARTS_BLOCKS     5
#define ROAD_MATERIAL_SIZE    8

PROGMEM const uint8_t roadData[] = {
// road data length
0x24,
// Parts Data x 4 =
// one screen
// (128 x 64)
0x00, 0x00, 0x00, 0x00,
0x00, 0x00, 0x00, 0x01,
0x02, 0x02, 0x02, 0x03,
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0x00, 0x00, 0x00, 0x00,
};

PROGMEM const uint8_t roadPartsData[] = {
// 0x00
0x01, 0x01, 0x01, 0x01,
0x10, 0x10, 0x10, 0x10,
0x00, 0x00, 0x00, 0x00,
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0x01, 0x01, 0x01, 0x01,
// 0x01
0x01, 0x01, 0x01, 0x01,
0x11, 0x12, 0x13, 0x14,
0x00, 0x00, 0x16, 0x17,
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0x01, 0x06, 0x20, 0x1f,
// 0x02
0x01, 0x01, 0x01, 0x01,
0x15, 0x15, 0x15, 0x15,
0x18, 0x18, 0x18, 0x18,
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0x1e, 0x1e, 0x1e, 0x1e,
// 0x03
0x01, 0x01, 0x01, 0x01,
0x14, 0x13, 0x12, 0x11,
0x17, 0x16, 0x00, 0x00,
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0x1f, 0x20, 0x06, 0x01,
// 0x04
0x01, 0x02, 0x15, 0x14,
0x0f, 0x0e, 0x18, 0x17,
0x00, 0x00, 0x00, 0x00,
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0x01, 0x06, 0x20, 0x1f,
// 0x05
0x13, 0x13, 0x13, 0x13,
0x16, 0x16, 0x16, 0x16,
0x00, 0x00, 0x00, 0x00,
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0x1e, 0x1e, 0x1e, 0x1e,
// 0x06
0x14, 0x15, 0x01, 0x01,
0x17, 0x18, 0x0e, 0x0f,
0x00, 0x00, 0x00, 0x00,
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0x1f, 0x20, 0x06, 0x01,
// 0x07
0x01, 0x01, 0x01, 0x01,
0x10, 0x10, 0x10, 0x10,
0x00, 0x00, 0x00, 0x00,
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0x01, 0x01, 0x01, 0x01,
// 0x08
0x01, 0x01, 0x01, 0x01,
0x11, 0x12, 0x13, 0x14,
0x00, 0x00, 0x16, 0x17,
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0x01, 0x06, 0x20, 0x1f,
// 0x09
0x01, 0x01, 0x01, 0x01,
0x15, 0x15, 0x15, 0x15,
0x18, 0x18, 0x18, 0x18,
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0x1e, 0x1e, 0x1e, 0x1e,
};

PROGMEM const uint8_t roadMaterialData[] = {
// parts
0x11, 0x44, 0x11, 0x44, 0x11, 0x44, 0x11, 0x44,
// parts (top)
0x11, 0x04, 0x11, 0x04, 0x11, 0x04, 0x11, 0x04, 
0x01, 0x04, 0x01, 0x04, 0x01, 0x04, 0x01, 0x04, 
0x01, 0x00, 0x01, 0x00, 0x01, 0x00, 0x01, 0x00,
0x01, 0x04, 0x01, 0x04, 0x01, 0x04, 0x01, 0x04,
// parts (bottom)
0x10, 0x44, 0x10, 0x44, 0x10, 0x44, 0x10, 0x44,
0x10, 0x40, 0x10, 0x40, 0x10, 0x40, 0x10, 0x40, 
0x00, 0x40, 0x00, 0x40, 0x00, 0x40, 0x00, 0x40, 
0x00, 0x40, 0x10, 0x40, 0x10, 0x40, 0x10, 0x40,
// centerline
0x80, 0x00, 0x80, 0x00, 0x80, 0x00, 0x80, 0x00,
0x20, 0x00, 0x20, 0x00, 0x20, 0x00, 0x20, 0x00,
0x08, 0x00, 0x08, 0x00, 0x08, 0x00, 0x08, 0x00,
0x02, 0x00, 0x02, 0x00, 0x02, 0x00, 0x02, 0x00,
// side line (top)
0x05, 0x0d, 0x0d, 0x0d, 0x09, 0x01, 0x01, 0x01,
0x0a, 0x1a, 0x1a, 0x1a, 0x12, 0x02, 0x02, 0x02,
0x15, 0x34, 0x35, 0x34, 0x25, 0x04, 0x05, 0x04,
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0x02, 0x06, 0x06, 0x06, 0x04, 0x00, 0x00, 0x00,
// side line (bottom)
0xa0, 0xb0, 0xb0, 0xb0, 0x90, 0x80, 0x80, 0x80,
0x50, 0x58, 0x58, 0x58, 0x48, 0x40, 0x40, 0x40,
0x28, 0x2c, 0x2c, 0x2c, 0x24, 0x20, 0x20, 0x20,  
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0x40, 0x60, 0x60, 0x60, 0x20, 0x00, 0x00, 0x00,
// rock
0x38, 0x44, 0x82, 0x89, 0x85, 0x81, 0x42, 0x3c,
};

PROGMEM const uint16_t roadMaterialCollisionData[] = {
// 0x0000
//   |||+ height 1-8
//   ||+- width 1-8  
//   |+-- y 0-7 + 0b1000 (Slowest flag) 
//   +--- x 0-7 + 0b1000 (Slow flag) 
        0x0888, 0x0885, 0x0883, 0x0881, 0x0883, 0x0a86, 0x0c84, 
0x0e82, 0x0c84, 0x0000, 0x0000, 0x0000, 0x0000, 0x8084, 0x8084, 
0x8086, 0x8087, 0x8088, 0x8088, 0x8088, 0x8781, 0x8081, 0x8082, 
0x8083, 0x8484, 0x8385, 0x8286, 0x8187, 0x8088, 0x8088, 0x8088,
0x8088, 0x8781, 0x8682, 0x8583, 0x0088, 0x0000, 0x0000, 0x0000, 
};

struct RoadRect
{
  int x;
  int y;
  uint8_t width;
  uint8_t height;
  boolean isSlow;
  boolean isSlowest;
};

struct Road
{
  public:
  uint8_t pos;
  uint8_t len;
  uint8_t cnt;
  int x;
  RoadRect rect[32];
  int16_t rect_cnt;

  void set()
  {
    pos = 0;
    len = 0;
    cnt = 0;
    rect_cnt = 0;
  }
};

Road road;

void drawRoadParts(int16_t x, int16_t y, uint8_t id)
{
  uint8_t parts_pos = id * 32;

  for (uint8_t row = 0; row < ROAR_PARTS_ROWS; row++)
  {
    for (uint8_t column = 0; column < ROAD_PARTS_COLUMNS; column++)
    {
      uint8_t road_part = pgm_read_byte_near(roadPartsData + parts_pos + (row * ROAD_PARTS_COLUMNS) + column);
      int16_t xx = x + (column * ROAD_MATERIAL_SIZE);
      int16_t yy = y + (row * ROAD_MATERIAL_SIZE);
      if(road_part == 0)
      {
        arduboy.fillRect(xx, yy, ROAD_MATERIAL_SIZE, ROAD_MATERIAL_SIZE, BLACK);
      }
      else
      {
        arduboy.drawBitmap(xx, yy, roadMaterialData + ((road_part - 1) * ROAD_MATERIAL_SIZE), 
        ROAD_MATERIAL_SIZE, ROAD_MATERIAL_SIZE, WHITE);

        if (xx >= 8 && (xx <= (player.x + CAR_WIDTH)) &&
        (pgm_read_word_near(roadMaterialCollisionData + (road_part - 1)) != 0))
        {
          uint16_t c = pgm_read_word_near(roadMaterialCollisionData + (road_part - 1));
          
          uint8_t xy = highByte(c);
          uint8_t wh = lowByte(c);

          road.rect[ road.rect_cnt ] = {
            .x = xx + ((xy >> 4) & 0b00000111), 
            .y = yy + (xy & 0b00000111),
            .width = (wh >> 4),
            .height = (wh & 0b00001111),
            .isSlow = bitRead(xy, 7),
            .isSlowest = bitRead(xy, 3)
          };          

          road.rect_cnt++;          
        }
      }
    }  
  }  
}

bool roadCollide(Rect rect1, RoadRect rect2)
{
  return !( rect2.x                 >=  rect1.x + rect1.width    ||
            rect2.x + rect2.width   <=  rect1.x                ||
            rect2.y                 >=  rect1.y + rect1.height ||
            rect2.y + rect2.height  <=  rect1.y);
}

void drawRoad()
{
  road.cnt = road.cnt + player.speed;
  road.x = road.x + player.speed;
  player.isMoveUp = true;
  player.isMoveDown = true;
  player.isSlow = false;
  player.isSlowest = false;
  road.rect_cnt = 0;

  if (road.len == 0)
  {
    road.len = pgm_read_byte_near(roadData);
    road.pos = 1;
  }
   
  for (uint8_t block = 0; block < ROAD_PARTS_BLOCKS; block++)
  {
    drawRoadParts((block * ROAR_PARTS_ROWS * ROAD_PARTS_COLUMNS) - road.cnt, 0,
    pgm_read_byte_near(roadData + road.pos + block));
  }

  if (road.cnt >= ROAR_PARTS_ROWS * ROAD_PARTS_COLUMNS)
  {
    road.cnt = 0;
    road.pos++;

    // loop (test only)
    if (road.pos > (road.len - ROAD_PARTS_BLOCKS))
    {
      road.pos = 1;
      road.x = 0;
    }
  }

  for (uint8_t i = 0; i < road.rect_cnt; i++)
  {
    if (roadCollide({.x = player.x, .y = player.y, .width = CAR_WIDTH, .height = CAR_HEIGHT}, road.rect[i]))
    {
      if (road.rect[i].isSlowest)
      {
        player.isSlowest = true;
      }
      else
      if (road.rect[i].isSlow && !player.isSlowest)
      {
        player.isSlow = true;
      }
    }
  }  

  //test
  if (arduboy.collide({.x = player.x, .y = player.y, .width = CAR_WIDTH, .height = CAR_HEIGHT}, 
  {.x = enemy.x, .y = enemy.y, .width = CAR_WIDTH, .height = CAR_HEIGHT}))
  {
    player.isClash = true;
  }

  if (player.speed < 2)
  {
    if (enemy.x < 128)
    {
      enemy.x += 2;
    }
  }
  else
  {
    enemy.x--;
  }
  if (enemy.x < -16) {
    enemy.x = 128;
  }
}

#endif
